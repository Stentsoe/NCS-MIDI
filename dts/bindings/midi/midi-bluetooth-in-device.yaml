## dts/bindings/midi/midi-bluetooth-in-device.yaml
```yaml
# Copyright (c) 2020 Nordic Semiconductor ASA
# SPDX-License-Identifier: Apache-2.0

# Specific fields for MIDI device.

description: MIDI.

compatible: "midi-bluetooth-in-device"

include: midi-bluetooth-device.yaml

# properties:
#   direction:
#     type: string
#     required: true
#     description: Direction of the port
#     enum:
#            - "OUT"
#            - "IN"
```

## dts/bindings/midi/midi-bluetooth-out-device.yaml
```yaml
# Copyright (c) 2020 Nordic Semiconductor ASA
# SPDX-License-Identifier: Apache-2.0

# Specific fields for MIDI device.

description: MIDI.

compatible: "midi-bluetooth-out-device"

include: midi-bluetooth-device.yaml
```

## dts/bindings/midi/midi-iso-broadcaster-device.yaml
```yaml
description: MIDI.

compatible: "midi-iso-broadcaster-device"

include: midi-iso-device.yaml
```

## dts/bindings/midi/midi-iso-device.yaml
```yaml
description: MIDI.

compatible: "midi-iso-device"

properties:
  label:
    required: true
    type: string
    description: Human readable string describing the 
        device (used as device_get_binding() argument)
```

## dts/bindings/midi/midi-iso-receiver-device.yaml
```yaml
description: MIDI.

compatible: "midi-iso-receiver-device"

include: midi-iso-device.yaml
```

## dts/bindings/midi/midi-serial-in-device.yaml
```yaml
# Copyright (c) 2020 Nordic Semiconductor ASA
# SPDX-License-Identifier: Apache-2.0

# Specific fields for MIDI device.

description: MIDI.

compatible: "midi-serial-in-device"

include: midi-device.yaml



    
```

## dts/bindings/midi/midi-serial-out-device.yaml
```yaml
# Copyright (c) 2020 Nordic Semiconductor ASA
# SPDX-License-Identifier: Apache-2.0

# Specific fields for MIDI device.

description: MIDI.

compatible: "midi-serial-out-device"

include: midi-serial-device.yaml

properties:
  handle-timestamps:
    required: false
    type: boolean



    
```

## dts/bindings/test/test-input-gpio.yaml
```yaml
# Copyright (c) 2023 Libre Solar Technologies GmbH
# SPDX-License-Identifier: Apache-2.0

description: GPIO pin used for testing

compatible: "test-input-gpio"

properties:
  gpios:
    type: phandle-array
    required: true
    description: |
      Output GPIO used for testing.
```

## dts/bindings/test/test-output-gpio.yaml
```yaml
# Copyright (c) 2023 Libre Solar Technologies GmbH
# SPDX-License-Identifier: Apache-2.0

description: GPIO pin used for testing

compatible: "test-output-gpio"

properties:
  gpios:
    type: phandle-array
    required: true
    description: |
      Input GPIO used for testing.
```

## dts/bindings/usb/usb-midi-device.yaml
```yaml
# Copyright (c) 2020 Nordic Semiconductor ASA
# SPDX-License-Identifier: Apache-2.0

# Specific fields for USB MIDI device.

description: USB MIDI.

compatible: "usb-midi-device"

properties:
  label:
    required: true
    type: string
    description: Human readable string describing the device (used as device_get_binding() argument)
```

## dts/bindings/usb/usb-midi-endpoint.yaml
```yaml
# Copyright (c) 2020 Nordic Semiconductor ASA
# SPDX-License-Identifier: Apache-2.0

# Specific fields for USB MIDI OUT jack.

description: USB MIDI endpoint.

compatible: "usb-midi-endpoint"

properties:
  direction:
    type: string
    required: true
    description: Direction of the endpoint
    enum:
        - "IN"
        - "OUT"
  
  ep-num:
    type: int
    required: true
    description: Endpoint number from 1 to 8.
    enum:
      - 1
      - 2
      - 3
      - 4
      - 5
      - 6
      - 7
      - 8

  type:
    type: string
    required: false
    default: "BULK"
    description: Type of endppoint, Bulk or Interrupt. Interrupt is only used for MIDI 2.0.
    enum:
      - "BULK"
      - "INTERRUPT"

  interval:
    type: int
    required: false
    default: 0
    description: Intervall for polling endpoint Interrupt data transfers.
      
  assoc-entities:
    type: phandles
    required: false
    description: Jacks or group terminals connected to this endpoint.
```

## dts/bindings/usb/usb-midi-group-terminal-block.yaml
```yaml
# Copyright (c) 2020 Nordic Semiconductor ASA
# SPDX-License-Identifier: Apache-2.0

# Specific fields for USB MIDI OUT jack.

description: USB MIDI endpoint.

compatible: "usb-midi-group-terminal-block"

properties:
  id:
    type: int
    required: true
    description: ID of the group terminal block.

  type:
    type: string
    required: true
    description: Declare whether group terminals of the block is declared as IN, OUT or IN/OUT
    enum:
        - "OUT"
        - "IN"
        - "IN-OUT"

  group-terminal:
    type: int
    required: false
    default: 0
    description: Number of the first group terminal in this block.

  num-group-terminals:
    type: int
    required: false
    default: 1
    description: Number of group terminals spanned by this block.

  protocol:
    type: string
    required: false
    description: Sets whether group terminals use MIDI 1.0 or MIDI 2.0.
    enum: 
      - "UNKNOWN"
      - "MIDI_1_0_64"
      - "MIDI_1_0_64_TIMESTAMPS"
      - "MIDI_1_0_128"
      - "MIDI_1_0_128_TIMESTAMPS"
      - "MIDI_2_0"
      - "MIDI_2_0_TIMESTAMPS"

  in-bandwidth:
    type: int
    required: false
    default: 0
    description: Sets Maximum input bandwidth for IN group terminals in 4KB/s. 0 = unknown or not fixed, 1 = ~31.25kb/s

  out-bandwidth:
    type: int
    required: false
    default: 0
    description: Sets Maximum input bandwidth for OUT group terminals in 4KB/s. 0 = unknown or not fixed, 1 = ~31.25kb/s

  string:
    type: string
    required: false
    description: String describing the group terminal block
```

## dts/bindings/usb/usb-midi-in-jack.yaml
```yaml
# # Copyright (c) 2020 Nordic Semiconductor ASA
# # SPDX-License-Identifier: Apache-2.0

# # Specific fields for USB MIDI IN jack.

# description: USB MIDI IN jack.

# compatible: "usb-midi-in-jack"

# properties:
#   label:
#     type: string
#     required: true
#     description: String identifying the jack. Will be encoded into string descriptor, as well as being used to get port device genrated by external enpoints.

#   type:
#     type: string
#     required: true
#     description: type of the MIDI IN jack, embedded or external
#     enum:
#            - "EMBEDDED"
#            - "EXTERNAL"

#   id:
#     type: int
#     required: true
#     description: ID of the MIDI IN jack
```

## dts/bindings/usb/usb-midi-interface.yaml
```yaml
# Copyright (c) 2020 Nordic Semiconductor ASA
# SPDX-License-Identifier: Apache-2.0

# Specific fields for USB MIDI interface.

description: USB MIDI.

compatible: "usb-midi-interface"

properties:
  index:
    type: int
    required: true
    description: index of this interface
```

## dts/bindings/usb/usb-midi-jack-pair.yaml
```yaml
# Copyright (c) 2020 Nordic Semiconductor ASA
# SPDX-License-Identifier: Apache-2.0

# Specific fields for USB MIDI OUT jack.

description: USB MIDI OUT jack.

compatible: "usb-midi-jack-pair"

properties:
  label:
    type: string
    required: true
    description: String identifying the jack. Will be encoded into string descriptor, as well as being used to get port device genrated by external enpoints.

  type-out:
    type: string
    required: true
    description: type of the MIDI OUT jack, embedded or external
    enum:
           - "EMBEDDED"
           - "EXTERNAL"

  type-in:
    type: string
    required: true
    description: type of the MIDI IN jack, embedded or external
    enum:
           - "EMBEDDED"
           - "EXTERNAL"

  id-out:
    type: int
    required: true
    description: ID of the MIDI OUT jack

  # sources:
  #   type: phandles
  #   required: false
  #   description: Pointers to the in jack of wich the jack is connected.

  id-in:
    type: int
    required: false
    description: ID of the MIDI IN jack

  string:
    type: string
    required: false
    description: String describing the MIDI Jack Pair
```

## dts/bindings/usb/usb-midi-out-jack.yaml
```yaml
# Copyright (c) 2020 Nordic Semiconductor ASA
# SPDX-License-Identifier: Apache-2.0

# Specific fields for USB MIDI OUT jack.

description: USB MIDI OUT jack.

compatible: "usb-midi-out-jack"

properties:
  label:
    type: string
    required: true
    description: String identifying the jack. Will be encoded into string descriptor, as well as being used to get port device genrated by external enpoints.

  type:
    type: string
    required: true
    description: type of the MIDI OUT jack, embedded or external
    enum:
           - "EMBEDDED"
           - "EXTERNAL"
  id:
    type: int
    required: true
    description: ID of the MIDI OUT jack

  sources:
    type: phandles
    required: false
    description: Pointers to the in jack of wich the jack is connected.

  sources-pins:
    type: uint8-array
    required: false
    description: Pin number of connected source entities. Number of pins must match number of sources.

  string:
    type: string
    required: false
    description: String describing the MIDI OUT Jack
```

## dts/bindings/usb/usb-midi-setting.yaml
```yaml
# Copyright (c) 2020 Nordic Semiconductor ASA
# SPDX-License-Identifier: Apache-2.0

# Specific fields for USB MIDI device.

description: USB MIDI setting.

compatible: "usb-midi-setting"

properties:
  revision:
    type: string
    required: true
    description: Revision of the specification
    enum:
      - "MIDI 1.0"
      - "MIDI 2.0"

  
  index:
    type: int
    required: true
    description: index of this setting
```

## samples/api/bluetooth/peripheral_tx/Kconfig
```kconfig
source "Kconfig.zephyr"

config MIDI_TEST_MODE
	bool "Run sample in test mode"
  default n

if MIDI_TEST_MODE

config MIDI_TEST_ACK_DROPOUT_INTERVAL
	int "Acknowledge dropout interval"
    default 10 
	default 8 if MIDI_TEST_DROP_EVERY_8TH
	help
	  Drop a MIDI acknowledge message every Nth message.

endif # MIDI_TEST_MODE
```

## subsys/Kconfig
```kconfig
# menu "Sub Systems and OS Services"

rsource "bluetooth/Kconfig"

rsource "usb/Kconfig"

# endmenu
```

## subsys/midi/Kconfig
```kconfig
#
# Copyright (c) 2019 Nordic Semiconductor ASA
#
# SPDX-License-Identifier: LicenseRef-Nordic-5-Clause
#



config MIDI
	bool "MIDI library"

menuconfig MIDI_PARSER
	bool "MIDI parser library"

if MIDI_PARSER
	config MIDI_PARSER_SYSEX_MAX_SIZE
		int "Maximum size of sysex message"
		default 255
		help
		  Maximum size of sysex message.

endif # MIDI_PARSER

config MIDI_SYNC
	bool "MIDI sync library"

config MIDI_SERIAL
	bool "MIDI serial library"

config MIDI_BLUETOOTH_PERIPHERAL
	bool "MIDI bluetooth peripheral library"

config MIDI_BLUETOOTH_CENTRAL
	bool "MIDI bluetooth central library"

config MIDI_ISO_BROADCASTER
	bool "MIDI iso broadcaster library"

config MIDI_ISO_RECEIVER
	bool "MIDI iso receiver library"

config MIDI_UMP
	bool "MIDI ump library"

config MIDI_SYSEX
	bool "MIDI sysex library"

config MIDI_CI
	bool "MIDI ci library"
	select MIDI_SYSEX

menuconfig MIDI_ACK
	bool "Enhanced ShockBurst"
	select NRFX_PPI if HAS_HW_NRF_PPI
	select NRFX_DPPI if HAS_HW_NRF_DPPIC
	select MPSL
	select MPSL_FEM_ONLY if !ESB_DYNAMIC_INTERRUPTS
	select NRFX_TIMER2
	default n
	help
	  Enable MIDI ACK functionality.

if MIDI_ACK
	config MIDI_ACK_RADIO_IRQ_PRIORITY
		int "MIDI ACK radio IRQ priority"
		default 1
		range 0 5

	config MIDI_ACK_EVENT_IRQ_PRIORITY
		int "MIDI ACK radio IRQ priority"
		default 2
		range 0 5


endif # MIDI_ACK
```

## subsys/usb/Kconfig
```kconfig
# USB device stack configuration options

# Copyright (c) 2016 Wind River Systems, Inc.
# SPDX-License-Identifier: Apache-2.0

if USB_DEVICE_STACK

rsource "class/Kconfig"

endif # USB_DEVICE_STACK
```

## subsys/usb/class/midi _split_jack/Kconfig
```kconfig
# USB MIDI configuration options

# Copyright (c) 2020 Nordic Semiconductor ASA
# SPDX-License-Identifier: Apache-2.0

config USB_DEVICE_MIDI
	bool "USB MIDI Device Class Driver"
	help
	  USB MIDI Device Class driver.
	  Zephyr USB MIDI Class is considered experimental
	  and not full.
	  Device configuration is done via dt overlay.

if USB_DEVICE_MIDI

module = USB_MIDI
module-str = USB MIDI
source "subsys/logging/Kconfig.template.log_config"

endif #USB_DEVICE_MIDI
```

## west.yml
```yaml
# The west manifest file for the NCS-MIDI project.
#
# The per-installation west configuration file specifies the location of this
# manifest file. The "path" option in the [manifest] section of .west/config
# defines the folder that contains west.yml. The path is relative to the folder
# that contains .west.
#

manifest:
  version: "0.12"
  remotes:
      # nRF Connect SDK base URL.
    - name: ncs-midi
      url-base: https://github.com/stentsoe
  # The list of external projects for the nRF Connect SDK.
  #
  projects:
    - name: nrf
      remote: ncs-midi
      repo-path: sdk-nrf-midi
      revision: 0f514b9fc446f5a6fcea7e177095adfffbf13ef1
      import: true

# West-related configuration for the nrf_midi_priv repository.
  self:
    path: nrf_midi
```
