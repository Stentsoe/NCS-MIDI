## prj.conf
```kconfig
# Enable the UART driver
CONFIG_UART_ASYNC_API=y
CONFIG_NRFX_UARTE0=y

CONFIG_HEAP_MEM_POOL_SIZE=2048

# Enable the BLE stack
CONFIG_BT=y

CONFIG_BT_ISO_BROADCASTER=y
CONFIG_LOG=y
CONFIG_BT_DEVICE_NAME="Test ISO Broadcaster"

CONFIG_BT_ISO_MAX_CHAN=1
CONFIG_BT_ISO_TX_BUF_COUNT=2

# Just needs to send a uint32_t value
CONFIG_BT_ISO_TX_MTU=96
CONFIG_BT_CTLR_ADV_ISO=y
CONFIG_BT_CTLR_ADV_ISO_PDU_LEN_MAX=96
CONFIG_BT_CTLR_ADV_ISO_STREAM_MAX=1

CONFIG_BT_CTLR_ISOAL_SOURCES=1

CONFIG_BT_CTLR_ADV_DATA_LEN_MAX=96

# FIXME: Host needs CONFIG_BT_ISO_TX_MTU + 4 bytes for sequence number, and
# optionally additional + 4 bytes for timestamp when not using
# BT_ISO_TIMESTAMP_NONE in bt_iso_chan_send(), otherwise Host tries to fragment
# ISO data.
# When Host is fixed, CONFIG_BT_CTLR_ISO_TX_BUFFER_SIZE can inherit the
# CONFIG_BT_ISO_TX_MTU value.
CONFIG_BT_CTLR_ISO_TX_BUFFER_SIZE=100
CONFIG_BT_CTLR_ISOAL_SN_STRICT=n
CONFIG_BT_LL_SW_SPLIT=y


# Enable DK LED and Buttons library
CONFIG_DK_LIBRARY=y

# This example requires more workqueue stack
CONFIG_SYSTEM_WORKQUEUE_STACK_SIZE=4096

# Config logger
CONFIG_LOG=y
CONFIG_USE_SEGGER_RTT=y
CONFIG_LOG_BACKEND_RTT=y
CONFIG_LOG_BACKEND_UART=n

CONFIG_MIDI=y
CONFIG_MIDI_SERIAL=y
CONFIG_MIDI_ISO_BROADCASTER=y
CONFIG_MIDI_PARSER=y
```

## src/main.c
```c
#include <zephyr/types.h>
#include <zephyr/device.h>
#include <soc.h>

#include <dk_buttons_and_leds.h>
#include <midi/midi.h>
#include <midi/midi_iso.h>
#include <midi/midi_parser.h>

#include <zephyr/logging/log.h>

#define LOG_MODULE_NAME midi
LOG_MODULE_REGISTER(LOG_MODULE_NAME);

#define RUN_STATUS_LED DK_LED1
#define CON_STATUS_LED DK_LED2
#define RUN_LED_BLINK_INTERVAL 1000

const struct device *serial_midi_in_dev;
const struct device *serial_midi_out_dev;
const struct device *iso_midi_out_dev;

DEFINE_MIDI_PARSER_SERIAL(serial_parser);

static int midi_iso_sent(const struct device *dev,
			  midi_msg_t *msg,
			  void *user_data)
{
	LOG_INF("MIDI ISO sent!");
	
	midi_msg_unref(msg);

	return 0;
}

static int midi_serial_sent(const struct device *dev,
			  midi_msg_t *msg,
			  void *user_data)
{
	LOG_INF("MIDI SERIAL sent!");
	
	midi_msg_unref(msg);

	return 0;
}

static int midi_serial_received(const struct device *dev,
			  midi_msg_t *msg,
			  void *user_data)
{
	midi_msg_t *parsed_msg = midi_parse_serial(msg, &serial_parser);

	midi_msg_unref(msg);
	if (parsed_msg) {
		LOG_HEXDUMP_INF(parsed_msg->data, parsed_msg->len, "parsed:");
		midi_send(iso_midi_out_dev, parsed_msg);
	}
	
	return 0;
}

const struct device * get_port(const char* name, 
			midi_transfer cb, void *user_data)
{
	int err;
	const struct device * dev;
	dev = device_get_binding(name);

	if (!dev) {
		LOG_ERR("Can not get device: %s", name);
	}

	err = midi_callback_set(dev, cb, user_data);
	if (err != 0) {
		LOG_ERR("Can not set callbacks for device: %s", name);
	}

	return dev;
}

void main(void)
{
	int blink_status = 0;
	int err;
	LOG_INF("Running");

	/*SERIAL PORTS*/
	serial_midi_in_dev = get_port("SERIAL_MIDI_IN", 
			midi_serial_received, NULL);
	
	serial_midi_out_dev = get_port("SERIAL_MIDI_OUT", 
			midi_serial_sent, NULL);


	/*ISO PORTS*/
	iso_midi_out_dev = get_port("ISO_MIDI_BROADCASTER", 
			midi_iso_sent, NULL);

	LOG_INF("ports gotten");

	err = dk_leds_init();
	if (err) {
		LOG_ERR("Cannot init LEDs (err: %d)", err);
	}
	// midi_iso_advertise(iso_midi_out_dev);

	for (;;) {
		dk_set_led(RUN_STATUS_LED, (++blink_status) % 2);
		k_sleep(K_MSEC(RUN_LED_BLINK_INTERVAL));
	}
}
```
